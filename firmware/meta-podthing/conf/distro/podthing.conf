## firmware/meta-podthing/conf/distro/podthing.conf
```bitbake
require conf/distro/superbird.conf

DISTRO = "podthing"
DISTRO_NAME = "PodThing"
DISTRO_VERSION = "0.1.0"
MAINTAINER = "PodThing contributors"

SUPERBIRD_HOSTNAME = "podthing"
SUPERBIRD_MDNS_SERVICE_NAME = "PodThing"
SUPERBIRD_USB_GADGET_NAME = "PodThing"
SUPERBIRD_USB_GADGET_MANUFACTURER = "PodThing"
SUPERBIRD_USB_GADGET_PRODUCT = "PodThing Recovery"
SUPERBIRD_DESCRIPTION = "Spotify Car Thing running PodThing"

# Native wl_shm UI; no Chromium, phone projection or Prelude daemon.
PACKAGECONFIG:remove:pn-weston = "vnc headless xwayland rdp pipewire remoting"
DISTRO_FEATURES:remove = "x11 pulseaudio"
```

## firmware/meta-podthing/conf/layer.conf
```bitbake
BBPATH .= ":${LAYERDIR}"
BBFILES += "${LAYERDIR}/recipes-*/*/*.bb ${LAYERDIR}/recipes-*/*/*.bbappend"
BBFILE_COLLECTIONS += "podthing"
BBFILE_PATTERN_podthing = "^${LAYERDIR}/"
BBFILE_PRIORITY_podthing = "20"
LAYERSERIES_COMPAT_podthing = "wrynose"
LAYERDEPENDS_podthing = "core superbird"
```
